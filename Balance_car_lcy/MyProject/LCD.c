#include "main.h"

const uint8_t LCD_ASCII[95][16] = 
{
	//阴码 逐行式 字宽16 字高16 逆向 
	{0x00,0x00,0x00,0x00,0x00,0x00,0x00,0x00,0x00,0x00,0x00,0x00,0x00,0x00,0x00,0x00}, //   0
	{0x00,0x00,0x00,0x08,0x08,0x08,0x08,0x08,0x08,0x08,0x00,0x00,0x08,0x08,0x00,0x00}, // ! 1
	{0x00,0x48,0x24,0x24,0x12,0x00,0x00,0x00,0x00,0x00,0x00,0x00,0x00,0x00,0x00,0x00}, // " 2
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	{0x04,0x5A,0x20,0x00,0x00,0x00,0x00,0x00,0x00,0x00,0x00,0x00,0x00,0x00,0x00,0x00}, // ~ 94
};


//16位BMP 40X40 QQ图像取模数据
//Image2LCD取模选项设置
//水平扫描
//16位
//40X40
//不包含图像头数据
//自左至右
//自顶至底
//低位在前
unsigned char TEST_IMG[3200] = { /*0X00,0X10,0X28,0X00,0X28,0X00,0X01,0X1B,*/
	0XDB,0XDE,0X5D,0XEF,0X5D,0XEF,0X7D,0XEF,0X5D,0XEF,0X5D,0XEF,0X5D,0XEF,0X5D,0XEF,
	0X5D,0XEF,0X5D,0XEF,0X5D,0XEF,0X5D,0XEF,0X5D,0XEF,0X5D,0XEF,0X5D,0XEF,0XBE,0XF7,
	0XFF,0XFF,0XDE,0XFF,0X38,0XC6,0X92,0X8C,0X8E,0X6B,0X6E,0X6B,0X10,0X7C,0X96,0XAD,
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	0XE4,0XD2,0X6A,0XC3,0XB6,0XD5,0XFF,0XFF,0XFF,0XFF,0XFF,0XFF,0XFF,0XFF,0XFF,0XFF,
};



/*-------------------------------------------------------------------------------------------------------*/

/**
* @brief Init the LCD Module
*/
void LCD_INIT(void)
{
     LCD_RESET();

	   LCD_WR_COMMAND(0x36);   //Memory Data Access Control 
	   Delay_ms(100);
	   LCD_WR_DATA(0x70);      //Horizontal Mode
	
	   LCD_WR_COMMAND(0x3A);   //Interface Pixel Format 
	   LCD_WR_DATA(0x55);      //RGB565  16bit  65K
	 
	   LCD_WR_COMMAND(0xB2);   //Porch Control
	   LCD_WR_DATA(0x0C);
	   LCD_WR_DATA(0x0C);
	   LCD_WR_DATA(0x00);
	   LCD_WR_DATA(0x33);
	   LCD_WR_DATA(0x33);
	
	   LCD_WR_COMMAND(0xB7);   //Gate Control
	   LCD_WR_DATA(0x35);
	
	   LCD_WR_COMMAND(0xBB);   //Vcom Setting
	   LCD_WR_DATA(0x37);
		 
		 LCD_WR_COMMAND(0xC0);   //LCM Control
	   LCD_WR_DATA(0x2C);
		 
		 LCD_WR_COMMAND(0xC2);   //VDV and VRH Command Enable
	   LCD_WR_DATA(0x01);
	 
	   LCD_WR_COMMAND(0xC3);   //VRH Set
	   LCD_WR_DATA(0x12);
		  
		 LCD_WR_COMMAND(0xC4);   //VDV Setting
	   LCD_WR_DATA(0x20);
		 
		 LCD_WR_COMMAND(0xC6);   //FR Control 2
	   LCD_WR_DATA(0x0F);
		 
		 LCD_WR_COMMAND(0xD0);   //Power Control 1
	   LCD_WR_DATA(0xA4);
	   LCD_WR_DATA(0xA1);

     LCD_WR_COMMAND(0xE0);   //Positive Voltage Gamma Control
	   LCD_WR_DATA(0xD0);
	   LCD_WR_DATA(0x04);
     LCD_WR_DATA(0x0D);
	   LCD_WR_DATA(0x11);
		 LCD_WR_DATA(0x13);
	   LCD_WR_DATA(0x2B);
		 LCD_WR_DATA(0x3F);
	   LCD_WR_DATA(0x54);
		 LCD_WR_DATA(0x4C);
	   LCD_WR_DATA(0x18);
		 LCD_WR_DATA(0x0D);
	   LCD_WR_DATA(0x0B);
		 LCD_WR_DATA(0x1F);
	   LCD_WR_DATA(0x23);
		 
		 LCD_WR_COMMAND(0xE1);   //Negative Voltage Gamma Control
	   LCD_WR_DATA(0xD0);
	   LCD_WR_DATA(0x04);
     LCD_WR_DATA(0x0C);
	   LCD_WR_DATA(0x11);
		 LCD_WR_DATA(0x13);
	   LCD_WR_DATA(0x2C);
		 LCD_WR_DATA(0x3F);
	   LCD_WR_DATA(0x44);
		 LCD_WR_DATA(0x51);
	   LCD_WR_DATA(0x2F);
		 LCD_WR_DATA(0x1F);
	   LCD_WR_DATA(0x1F);
		 LCD_WR_DATA(0x20);
	   LCD_WR_DATA(0x23);

     LCD_WR_COMMAND(0x21);       //Display inversion on
		 
		 LCD_WR_COMMAND(0x11);       //Sleep mode off
		 Delay_ms(120);
		 
		 LCD_WR_COMMAND(0x29);       //Display on
		 LCD_FILL(LCD_BGC);
		 
		 LCD_DISP_STR(120,200,"ABCDEFG");
		 LCD_DISP_STR(120,120,"ANGLE:");

}

/**
* @Brief: Reset the LCD
*/
void LCD_RESET(void)
{
     LCD_RST_LOW();
	   Delay_ms(200);
	   LCD_RST_HIGH();
	   Delay_ms(100);
}

/**
* @Brief: Set the display region of LCD
*/
void LCD_SET_REGION(uint16_t x1, uint16_t y1, uint16_t x2, uint16_t y2)
{
     LCD_WR_COMMAND(0x2A);      //Column Address Set
	   LCD_WR_DATA_16b(x1+52);
	   LCD_WR_DATA_16b(x2+52);
	 
	   LCD_WR_COMMAND(0x2B);      //Row Address Set
	   LCD_WR_DATA_16b(y1+40);
	   LCD_WR_DATA_16b(y2+40);
	
	   LCD_WR_COMMAND(0x2C);      //Memory Write
}

/**
* @Brief: FILL the LCD with one colour
*/
void LCD_FILL(uint16_t colour)
{
     uint16_t i,j;
	
	   LCD_SET_REGION(0, 0, LCD_Hight-1, LCD_Width-1);
	
	   for(i=0; i<LCD_Width; i++)
	   {
		     for(j=0; j<LCD_Hight; j++)
			   {
				     LCD_WR_DATA_16b(colour);
				 }
		 }
}


/**
* @brief LCD Display a dot
*/
void LCD_DISP_DOT(uint16_t x, uint16_t y, uint16_t colour)
{
     LCD_SET_REGION(x,y,x,y);
	  
	   LCD_WR_DATA_16b(colour);
}


/**
* @brief LCD Display a character
*/
void LCD_DISP_CHAR(uint16_t x, uint16_t y, char dat)
{
     int8_t i,j;
	   uint8_t temp;
	   
	   for(i=0; i<16; i++)
	   {
			   LCD_SET_REGION(x, y+i, x+7, y+i);
			   temp = LCD_ASCII[dat-32][15-i];
	       for(j=7; j>=0; j--)
         {
				     if(temp & (1<<j))
						    LCD_WR_DATA_16b(LCD_TXC);
						 else
							  LCD_WR_DATA_16b(LCD_BGC);
				 }			 
		 }
}


/**
* @brief LCD Display a string
*/
void LCD_DISP_STR(uint16_t x, uint16_t y, const char str[])
{
     uint16_t i = 0;

	   while(str[i]!='\0')
	   {
		     LCD_DISP_CHAR(x-8*i, y, str[i]);
         i++;
		 }
}


/**
* @brief LCD Display a uint8
*/
void LCD_DISP_UINT8(uint16_t x, uint16_t y, uint8_t dat)
{
     uint8_t a[3];
	   uint8_t i=0;
	
	   a[2] = dat % 10;
	   a[1] = dat / 10 % 10;
	   a[0] = dat / 100;
	
     for(;i<3;i++)
	   {
		     LCD_DISP_CHAR(x-8*i, y, '0'+a[i]);
		 }
}


/**
* @brief LCD Display a int8
*/
void LCD_DISP_INT8(uint16_t x, uint16_t y, int8_t dat)
{
     uint8_t a[3];
	   uint8_t i = 0;
	
	   if(dat<0)
		 {
		    dat = -dat;
			  LCD_DISP_CHAR(x,y,'-');
		 }
		 else
		 {
		    LCD_DISP_CHAR(x,y,' ');
		 }
	 
	   a[2] = dat % 10;
	   a[1] = dat / 10 % 10;
	   a[0] = dat / 100;
	
     for(;i<3;i++)
	   {
		     LCD_DISP_CHAR(x-8*(i+1), y, '0'+a[i]);
		 }
}


/**
* @brief LCD Display a uint16
*/
void LCD_DISP_UINT16(uint16_t x, uint16_t y, uint16_t dat)
{
     uint8_t a[5];
	   uint8_t i = 0;
	
	   a[4] = dat % 10;
	   a[3] = dat / 10 % 10;
	   a[2] = dat / 100 % 10;
	   a[1] = dat / 1000 % 10;
	   a[0] = dat / 10000;
	
     for(;i<5;i++)
	   {
		     LCD_DISP_CHAR(x-8*i, y, '0'+a[i]);
		 }
}


/**
* @brief LCD Display a int16
*/
void LCD_DISP_INT16(uint16_t x, uint16_t y, int16_t dat)
{
     uint8_t a[5];
	   uint8_t i = 0;
	
	   if(dat < 0)
		 {
		    dat = -dat;
			  LCD_DISP_CHAR(x,y,'-');		    
		 }
		 else
     {
		    LCD_DISP_CHAR(x,y,' ');
		 }
	
	   a[4] = dat % 10;
	   a[3] = dat / 10 % 10;
	   a[2] = dat / 100 % 10;
	   a[1] = dat / 1000 % 10;
	   a[0] = dat / 10000;
	
     for(;i<5;i++)
	   {
		     LCD_DISP_CHAR(x-8*(i+1), y, '0'+a[i]);
		 }
}


/**
* @brief LCD Display a int8~32
*/
void LCD_DISP_INT32(uint16_t x, uint16_t y, int32_t dat)
{
     char  BUFF[15];
//	   uint8_t  str_length; 
	  
	   if(dat <0)
		 {
	      sprintf(BUFF, "%d", dat);
		 }
		 else 
		 {
		    BUFF[0] = ' ';
			  sprintf(&BUFF[1], "%d", dat);
		 }
	   
	   LCD_DISP_STR(x, y, BUFF);
}
 

/**
* @brief LCD Display a float
*/
void LCD_DISP_FLOAT(uint16_t x, uint16_t y, double dat, uint8_t num, uint8_t pnum)
{
	   char    BUFF[20];
	   char    a[9];

     if(pnum > 5)   pnum = 5;
	   if(num  > 9)   num  = 9;
	
	   a[0] = '%';
	   a[1] = '-';
	   a[2] = '0';
	   if((num+pnum+1)>=10)
		 {
		     a[3] = '1';
			   a[4] = '0'+(num+pnum+1)%10;
			   a[5] = '.';
			   a[6] = '0'+ pnum;
			   a[7] = 'f';
			   a[8] = '\0';
		 }
		 else
		 {
		     a[3] = '0'+num+pnum+1;
			   a[4] = '.';
			   a[5] = '0'+ pnum;
			   a[6] = 'f';
			   a[7] = '\0';
		 }
	
	   if(dat < 0)
		 {
		    sprintf(BUFF, a, dat);
		 }
		 else
     {
			  BUFF[0]    = ' ';
		    sprintf(&BUFF[1], a, dat);
		 }

     LCD_DISP_STR(x, y, BUFF);		 

}


/**
* @brief LCD Display image from camera (grey level)
*/
void LCD_DISP_CAMIMG(uint8_t p[IMG_H][IMG_W], uint16_t width, uint16_t hight)
{
     uint16_t i,j;
	   uint16_t colour = 0;
	   uint16_t temp   = 0;
	
	   uint16_t coord_x = 0;
	   uint16_t coord_y = 0;
	
	   coord_x = (width > LCD_Hight? LCD_Hight: width);
	   coord_y = (hight > LCD_Width? LCD_Width: hight);
	
	   LCD_SET_REGION(0, 0, coord_x-1, coord_y-1);
	
	   for(j = 0; j < coord_y; j++)
	   {
		     for(i = 0; i < coord_x; i++)
			   {
				   temp = p[i][coord_y-j];				 
					 
			     colour=(0x001f&((temp)>>3))<<11;
			     colour=colour|(((0x003f)&((temp)>>2))<<5);
			     colour=colour|(0x001f&((temp)>>3));					   
					 
					   LCD_WR_DATA_16b(colour);
				 }    
		 }
}



/**
* @brief LCD Display RGB image 
*/
void LCD_DISP_RGBIMG(unsigned char *p, uint16_t width, uint16_t hight, uint16_t x, uint16_t y)
{
     uint16_t i,j;
	   uint16_t colour = 0;
	
	   uint16_t coord_x = 0;
	   uint16_t coord_y = 0;
	
	   coord_x = (width > LCD_Hight? LCD_Hight: width);
	   coord_y = (hight > LCD_Width? LCD_Width: hight);
	
	   LCD_SET_REGION(x, y, x+coord_x-1, y+coord_y-1);
	
	   for(j = 0; j < coord_y; j++)
	   {
		     for(i = 0; i < coord_x; i++)
			   {			     				 
					   colour = *(p + j*width + i*width/coord_x);					 
					   LCD_WR_DATA_16b(colour);
				 }    
		 }
}


/**************************Basic Commands*************************/

/**
* @Brief: Write a Command to the LCD
*/
void LCD_WR_COMMAND(uint8_t com)
{
     LCD_CS_LOW();
	   LCD_DC_LOW();
	 
	   SPI2_Write_Byte(com);  
	
	   LCD_CS_HIGH();
}

/**
* @Brief: Write Data(1 Byte) to the LCD
*/
void LCD_WR_DATA(uint8_t dat)
{
     LCD_CS_LOW();
	   LCD_DC_HIGH();
	 
	   SPI2_Write_Byte(dat);  
	
	   LCD_CS_HIGH();
}

/**
* @Brief: Write Data(2 Byte) to the LCD
*/
void LCD_WR_DATA_16b(uint16_t dat)
{
     LCD_CS_LOW();
	   LCD_DC_HIGH();
	 
	   SPI2_Write_Byte((uint8_t)(dat>>8));  
	   SPI2_Write_Byte((uint8_t)dat);

     LCD_CS_HIGH();
}
